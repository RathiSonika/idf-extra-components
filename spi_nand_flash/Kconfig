## spi_nand_flash/Kconfig
```kconfig
menu "SPI NAND Flash configuration"

    config NAND_FLASH_VERIFY_WRITE
        bool "Verify SPI NAND flash writes"
        default n
        help
            If this option is enabled, any time SPI NAND flash is written then the data will be read
            back and verified. This can catch hardware problems with SPI NAND flash, or flash which
            was not erased before verification.

    config NAND_FLASH_ENABLE_BDL
        bool "Enable Block Device Layer (BDL) support"
        depends on IDF_INIT_VERSION >= "6.0"
        default n
        help
            Enable Block Device Layer (BDL) support for SPI NAND Flash. This provides:
            - Standard esp_blockdev_t interface for layered architecture
            - Flash Block Device Layer (raw NAND flash access)
            - Wear-Leveling Block Device Layer (logical sector access with FTL)
              when NAND_FLASH_FTL_DHARA is selected
            - Advanced layered API (spi_nand_flash_init_with_layers) when an FTL
              is selected
            When disabled, only the legacy API is available.
            When enabled, the legacy spi_nand_flash_init_device() is not available (returns
            ESP_ERR_NOT_SUPPORTED). Use spi_nand_flash_init_with_layers() when Dhara
            is selected, or nand_flash_get_blockdev() for raw flash access.

            Note: This option requires ESP-IDF >= 6.0 (esp_blockdev component).
            Enabling this on ESP-IDF < 6.0 will result in a build error.

    choice NAND_FLASH_FTL
        prompt "NAND flash translation layer" if NAND_FLASH_ENABLE_BDL
        default NAND_FLASH_FTL_DHARA
        help
            Select the flash translation layer above the raw NAND flash driver.
            Without BDL this stays Dhara (the legacy API requires it) and the
            choice is hidden in menuconfig.

            Dhara provides logical mapping, wear leveling, bad-block handling,
            and garbage collection. "None" compiles Dhara out; use
            nand_flash_get_blockdev() for raw flash or a custom FTL on the Flash BDL.

            WARNING: "None" is NOT recommended for general storage or filesystem
            use. Raw NAND requires erase-before-program, bad-block handling, and
            wear management.

            After changing this option, delete the project's dependencies.lock and
            run "idf.py fullclean reconfigure". A stale lock may still pull
            espressif/dhara into the build.

        config NAND_FLASH_FTL_DHARA
            bool "Dhara"
            help
                Build espressif/dhara and dhara_glue.c. Used by the legacy API and
                the wear-leveling BDL.

        config NAND_FLASH_FTL_NONE
            bool "None (raw Flash BDL only)"
            depends on NAND_FLASH_ENABLE_BDL
            help
                No in-tree FTL. spi_nand_flash_init_with_layers() and
                spi_nand_flash_wl_get_blockdev() return ESP_ERR_NOT_SUPPORTED.
                Use nand_flash_get_blockdev() for raw access.

    endchoice

    config NAND_ENABLE_STATS
        bool "Host test statistics enabled"
        depends on IDF_TARGET_LINUX
        default n
        help
            This option enables gathering host test statistics and SPI NAND flash wear levelling simulation.

    config NAND_FLASH_GENERIC_CHIP_DETECTION
        bool "Enable generic SPI NAND chip detection"
        depends on NAND_FLASH_ENABLE_BDL && !IDF_TARGET_LINUX
        default n
        help
            When enabled, chip init bypasses the vendor database (including known JEDEC IDs)
            and uses ONFI parameter page geometry, falling back to
            NAND_FLASH_GENERIC_GEOMETRY_* when the parameter page is invalid.
            Access is via Flash BDL (nand_flash_get_blockdev) only: read-only by default,
            no Dhara/wear-leveling. Not for production FatFS mounts.
            When disabled, init is database-only (smaller binary).

    if NAND_FLASH_GENERIC_CHIP_DETECTION

        config NAND_FLASH_GENERIC_GEOMETRY_PAGE_SIZE
            int "Generic geometry fallback: page size in bytes"
            default 0
            range 0 8192
            help
                Used only when ONFI parameter page is missing or invalid.
                Data bytes per page from the datasheet. 0 means unset (parameter page required).
                When non-zero must be a power of two in 512..8192.

        config NAND_FLASH_GENERIC_GEOMETRY_PAGES_PER_BLOCK
            int "Generic geometry fallback: pages per block"
            default 0
            range 0 256
            help
                Used only when ONFI parameter page fails. 0 means unset.
                When non-zero must be a power of two in 32..256.

        config NAND_FLASH_GENERIC_GEOMETRY_NUM_BLOCKS
            int "Generic geometry fallback: number of blocks"
            default 0
            range 0 65536
            help
                Used only when ONFI parameter page fails. 0 means unset. Must be > 0 when used.

        config NAND_FLASH_GENERIC_NUM_PLANES
            int "Generic: number of planes"
            default 1
            range 1 4
            help
                Plane count for the generic path (ONFI or Kconfig geometry).
                Default 1 (single-plane). When > 1, program/read plane-select
                column addressing is enabled automatically. Set from the
                datasheet; incorrect values corrupt column addressing.

        config NAND_FLASH_GENERIC_T_R_US
            int "Generic: page read time (us)"
            default 100
            range 1 100000
            help
                Page read busy time (t_R). Used for Kconfig geometry, and when a
                CRC-valid ONFI page leaves tR at 0. A non-zero ONFI tR is kept.
                nand_wait_for_ready() times out at 10x this value. Prefer datasheet max.

        config NAND_FLASH_GENERIC_T_PROG_US
            int "Generic: page program time (us)"
            default 1000
            range 1 100000
            help
                Page program busy time (t_PROG). Used for Kconfig geometry, and when
                a CRC-valid ONFI page leaves tPROG at 0. A non-zero ONFI tPROG is kept.
                nand_wait_for_ready() times out at 10x this value. Prefer datasheet max.

        config NAND_FLASH_GENERIC_T_BERS_US
            int "Generic: block erase time (us)"
            default 10000
            range 1 1000000
            help
                Block erase busy time (t_BERS). Used for Kconfig geometry, and when
                a CRC-valid ONFI page leaves tBERS at 0. A non-zero ONFI tBERS is kept.
                nand_wait_for_ready() times out at 10x this value. Prefer datasheet max.

        config NAND_FLASH_GENERIC_WRITE_ERASE_ENABLE
            bool "Allow program/erase on generic chip path"
            default n
            help
                By default generic detection yields a read-only Flash BDL.
                Enable only for lab/bring-up. Initialization clears the chip
                protection register, unlocking all blocks, not only the intended
                disposable region. Flash contents may change. Still does not
                enable wear-leveling or FatFS.

    endif

endmenu
```
