## spi_nand_flash/Kconfig
```kconfig
menu "SPI NAND Flash configuration"

    config NAND_FLASH_VERIFY_WRITE
        bool "Verify SPI NAND flash writes"
        default n
        help
            If this option is enabled, any time SPI NAND flash is written then the data will be read
            back and verified. This can catch hardware problems with SPI NAND flash, or flash which
            was not erased before verification.

    config NAND_FLASH_ENABLE_BDL
        bool "Enable Block Device Layer (BDL) support"
        depends on IDF_INIT_VERSION >= "6.0"
        default n
        help
            Enable Block Device Layer (BDL) support for SPI NAND Flash. This provides:
            - Standard esp_blockdev_t interface for layered architecture
            - Flash Block Device Layer (raw NAND flash access)
            - Wear-Leveling Block Device Layer (logical sector access with wear leveling)
            - Advanced layered API (spi_nand_flash_init_with_layers)
            When disabled, only the legacy API is available.
            When enabled, the legacy spi_nand_flash_init_device() is not available (returns
            ESP_ERR_NOT_SUPPORTED). Use spi_nand_flash_init_with_layers().

            Note: This option requires ESP-IDF >= 6.0 (esp_blockdev component).
            Enabling this on ESP-IDF < 6.0 will result in a build error.

    config NAND_FLASH_TRANSPORT_GPSPI
        bool "Enable GPSPI transport backend"
        default y
        depends on !IDF_TARGET_LINUX
        help
            Compile the GPSPI (spi_master) transport used by external SPI NAND.
            Application init continues to pass spi_device_handle_t and typically
            mounts via WL BDL.

    config NAND_FLASH_TRANSPORT_MSPI
        bool "Enable MSPI transport backend (primary NAND scaffold)"
        default n
        depends on !IDF_TARGET_LINUX
        help
            Compile the MSPI transport used for primary NAND bring-up (Raw NAND
            path / loader). Not selected by normal applications; system code uses
            spi_nand_flash_primary.h. MSPI host wiring is still scaffolded.

    config NAND_ENABLE_STATS
        bool "Host test statistics enabled"
        depends on IDF_TARGET_LINUX
        default n
        help
            This option enables gathering host test statistics and SPI NAND flash wear levelling simulation.

endmenu
```
