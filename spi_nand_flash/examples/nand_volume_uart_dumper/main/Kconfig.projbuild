## spi_nand_flash/examples/nand_volume_uart_dumper/main/Kconfig.projbuild
```kconfig
menu "NAND volume dumper"

    config EXAMPLE_DUMP_UART_PORT_NUM
        int "UART port number for binary dump (0 or 1)"
        range 0 2
        default 1
        help
            UART used for the binary dump stream and handshake.
            Use **0** with TX/RX GPIOs matching your board (ESP32: usually GPIO1/3) when that UART is the same as
            `CONFIG_ESP_CONSOLE_UART_NUM` (typical UART0 = same cable as `idf.py flash`). The app calls
            `esp_stdio_uninstall_io_driver()` in that case — do not run `idf.py monitor` on that port while dumping.
            Keep default **1** if you want UART0 free for monitor while dumping on UART1.

    config EXAMPLE_DUMP_UART_BAUD
        int "UART baud rate for dump"
        default 921600
        help
            Higher baud (921600) greatly reduces transfer time. Use 115200 if the link is unreliable.

    config EXAMPLE_DUMP_READ_CHUNK_PAGES
        int "Logical pages read per block device read (batching)"
        range 1 128
        default 64
        help
            Read this many logical pages in one esp_blockdev read, then emit UART records for that buffer.
            Larger values speed up NAND + UART (capped in code to ~256 KiB buffer). Lower if RAM is tight.

    config EXAMPLE_DUMP_UART_TX_PIN
        int "UART TX GPIO (dump port)"
        default 17

    config EXAMPLE_DUMP_UART_RX_PIN
        int "UART RX GPIO (dump port, for handshake)"
        default 18

    config EXAMPLE_DUMP_SPARSE_FF
        bool "Sparse UART transfer: skip all-0xFF logical chunks"
        default y
        help
            When enabled, the device sends SKIP/DATA records instead of one raw stream. Chunks that read
            as all 0xFF (typical erased NAND) are not sent as payload. The host script still builds a
            full disk_size image (holes filled with 0xFF) for tools like fatfsparse.py.
            Disable for a legacy contiguous binary stream (header magic NDLV).

endmenu
```

## spi_nand_flash/examples/nand_volume_uart_dumper/sdkconfig.defaults
```kconfig
# BDL + Dhara wear-level path (ESP-IDF >= 6.0)
CONFIG_NAND_FLASH_ENABLE_BDL=y

# Skip all-0xFF chunks on UART (smaller/faster transfer; host still builds full image)
CONFIG_EXAMPLE_DUMP_SPARSE_FF=y

# Batched blockdev reads before UART (see main/Kconfig.projbuild)
CONFIG_EXAMPLE_DUMP_READ_CHUNK_PAGES=64
CONFIG_EXAMPLE_DUMP_IOCTL_SKIP_UNMAPPED=y

# Console baud (UART0); dump port baud is set in firmware from Kconfig
CONFIG_ESP_CONSOLE_UART_BAUDRATE=115200
CONFIG_EXAMPLE_DUMP_UART_BAUD=115200

# Long sequential reads: give the main task more time before TWDT fires
CONFIG_ESP_TASK_WDT_TIMEOUT_S=60
CONFIG_EXAMPLE_DUMP_UART_PORT_NUM=0
CONFIG_EXAMPLE_DUMP_UART_TX_PIN=1
CONFIG_EXAMPLE_DUMP_UART_RX_PIN=3
```

## spi_nand_flash_fatfs/examples/nand_flash_bdl/main/Kconfig.projbuild
```kconfig
menu "SPI NAND BDL example configuration"

    config EXAMPLE_FORMAT_IF_MOUNT_FAILED
        bool "Format the flash if mount failed"
        default n
        help
            If set, format_if_mount_failed is true and the volume is formatted when mount fails.

    config EXAMPLE_FORMAT_BEFORE_MOUNT
        bool "Format the volume before mount (explicit mkfs)"
        default n
        help
            If set, the example registers the WL BDL with FatFS diskio, runs esp_vfs_fat_format_drive()
            using the same esp_vfs_fat_mount_config_t (allocation unit, FAT count), then unregisters
            before calling esp_vfs_fat_bdl_mount(). Use this to force a filesystem layout that matches
            your mount_config without relying on format_if_mount_failed.

endmenu
```

## spi_nand_flash_vfs/examples/nand_flash_bdl/sdkconfig.defaults
```kconfig
CONFIG_NAND_FLASH_ENABLE_BDL=y
CONFIG_EXAMPLE_FORMAT_IF_MOUNT_FAILED=n
CONFIG_ESP_TASK_WDT_EN=n
```
